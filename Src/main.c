/* Includes ------------------------------------------------------------------*/
#include "main.h"
#include "usart.h"
#include "gpio.h"

/* Private includes ----------------------------------------------------------*/
/* USER CODE BEGIN Includes */
#include "stdio.h"
#include "app_nfc.h"
#include "display.h"
#include "adc.h"
#include "flash.h"

//picture 1
const unsigned char nfcBuffer1[]={
    0x00,0x00,0x00,0x00,0x00,0x00,0x00,0x00,0x01,0xA5,0x15,0x55,0x55,0x55,0x50,0x00,
0x00,0x00,0x00,0x00,0x00,0x00,0x00,0x05,0x55,0x00,0x00,0x00,0x00,0x00,0x00,0x00,
0x00,0x01,0xF4,0x00,0x00,0x00,0x00,0x00,0x00,0x00,0x00,0x00,0x00,0x00,0x00,0x00,
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0xFF,0xFF,0xD0,0x15,0xFF,0xFF,0xF4,0x00,
};


//Power 100%
const unsigned char BT_100[] = 
{
    0xFF,0xFF,0xFF,0xFF,0xFF,0xFF,0xFF,0xFF,0xFF,0xFF,0xFF,0xFF,0xFF,0xFF,0xFF,0xFF,
    0xFF,0xFF,0xFF,0xFF,0xFF,0xFF,0xFF,0xFF,0xFF,0xFF,0xFF,0xFF,0xFF,0xFF,0xFF,0xFF,
    0xFF,0xFF,0xFF,0xFF,0xFF,0xFF,0xFF,0xFF,0xFF,0xFF,0xFF,0xFF,0xFF,0xFF,0xFF,0xFF,
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    0xFF,0xFF,0xFF,0xFF,0xFF,0xFF,0xFF,0xFF,

};


//Power 75%
const unsigned char BT_75[] = 
{
    0xFF,0xFF,0xFF,0xFF,0xFF,0xFF,0xFF,0xFF,0xFF,0xFF,0xFF,0xFF,0xFF,0xFF,0xFF,0xFF,
    0xFF,0xFF,0xFF,0xFF,0xFF,0xFF,0xFF,0xFF,0xFF,0xFF,0xFF,0xFF,0xFF,0xFF,0xFF,0xFF,
    0xFF,0xFF,0xFF,0xFF,0xFF,0xFF,0xFF,0xFF,0xFF,0xFF,0xFF,0xFF,0xFF,0xFF,0xFF,0xFF,
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    0xFF,0xFF,0xFF,0xFF,0xFF,0xFF,0xFF,0xFF,

};
    

//Power 50%
const unsigned char BT_50[] = 
{
    0xFF,0xFF,0xFF,0xFF,0xFF,0xFF,0xFF,0xFF,0xFF,0xFF,0xFF,0xFF,0xFF,0xFF,0xFF,0xFF,
    0xFF,0xFF,0xFF,0xFF,0xFF,0xFF,0xFF,0xFF,0xFF,0xFF,0xFF,0xFF,0xFF,0xFF,0xFF,0xFF,
    0xFF,0xFF,0xFF,0xFF,0xFF,0xFF,0xFF,0xFF,0xFF,0xFF,0xFF,0xFF,0xFF,0xFF,0xFF,0xFF,
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    0xFF,0xFF,0xFF,0xFF,0xFF,0xFF,0xFF,0xFF,
};


//Power 25%
const unsigned char BT_25[] = 
{
    0xFF,0xFF,0xFF,0xFF,0xFF,0xFF,0xFF,0xFF,0xFF,0xFF,0xFF,0xFF,0xFF,0xFF,0xFF,0xFF,
    0xFF,0xFF,0xFF,0xFF,0xFF,0xFF,0xFF,0xFF,0xFF,0xFF,0xFF,0xFF,0xFF,0xFF,0xFF,0xFF,
    0xFF,0xFF,0xFF,0xFF,0xFF,0xFF,0xFF,0xFF,0xFF,0xFF,0xFF,0xFF,0xFF,0xFF,0xFF,0xFF,
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    0xFF,0xFF,0xFF,0xFF,0xFF,0xFF,0xFF,0xFF,
};

void SystemClock_Config(void);


unsigned char *nfcBuffer2;

int main(void)
{
    uint16_t i, BT_Num;
	uint32_t SUM[3];
	uint16_t ADC_DATA[101];
	uint16_t VREFINT_DATA[101];
	ADC_ChannelConfTypeDef sConfig;
	float V_CHANNEL = 0;
	int16_t ADC_value;

    HAL_Init();

    SystemClock_Config();

    MX_GPIO_Init();
     
    MX_USART1_UART_Init();
    
    MX_ADC_Init();
    
    /* USER CODE BEGIN 2 */
    MX_NFC_Init();
    
    LED_DisPlay();
    
    while (1)
    {              
        if(key_flag[0] == 1)
        {
            /* Default picture display */
            if(key_flag[2] == 1) 
            {
                LED_DisPlay();
                epd1in54_showbmp(nfcBuffer1); 
                key_flag[0] = 0; 
            }
            
            /* Battery percentage display */
            if(key_flag[2] == 2) 
            {
                LED_DisPlay();
                SUM[0] = 0;
                SUM[1] = 0;
                for(i=0; i<100; i++)
                {
                    
                    ADC_DATA[i] = 0;
                  
                    HAL_ADCEx_Calibration_Start(&hadc,ADC_SINGLE_ENDED);
                    
                    hadc.Instance->CHSELR=0;
                   
                    //ADC_IN1
                    sConfig.Channel = ADC_CHANNEL_1;
                   
                    HAL_ADC_ConfigChannel(&hadc, &sConfig);
                  
                    HAL_ADC_Start(&hadc);
                   
                    HAL_ADC_PollForConversion(&hadc,1000);
                 
                    ADC_DATA[i] = HAL_ADC_GetValue(&hadc);
               
                    HAL_ADC_Stop(&hadc);
                    SUM[0] += ADC_DATA[i];
                    
                   
                    VREFINT_DATA[i] = 0;
                    HAL_ADCEx_Calibration_Start(&hadc,ADC_SINGLE_ENDED);
                 
                    hadc.Instance->CHSELR=0;
          
                    //ADC_IN0
                    sConfig.Channel = ADC_CHANNEL_0;
                   
                    HAL_ADC_ConfigChannel(&hadc, &sConfig);
                
                    HAL_ADC_Start(&hadc);
                    
                    HAL_ADC_PollForConversion(&hadc,1000);
               
                    VREFINT_DATA[i] = HAL_ADC_GetValue(&hadc);
                   
                    HAL_ADC_Stop(&hadc);
                    SUM[1] += VREFINT_DATA[i];
                }
               
                //adc voltage average
                ADC_DATA[100] = SUM[0] / 100;
                //printf("ADC_DATA:%d\r\n",ADC_DATA[100]);
                
                //voltage reference average
                VREFINT_DATA[100] = SUM[1] / 100;
                //printf("VREFINT_DATA:%d\r\n",VREFINT_DATA[100]);
                
                /*channelx = 2.5V *ADC_DATAx/(VREFINT_DATA)*/
                V_CHANNEL = (float)(2.5*ADC_DATA[100])/(VREFINT_DATA[100]);
          
                ADC_value = V_CHANNEL * 1000;
                //printf("ADC:%dmv\r\n",ADC_value);
                
                BT_Num = (uint16_t)((1 - ((2105 - (ADC_value)) / (2105 - 1375))) * 100);
                //printf("BT_Num:%d\r\n",BT_Num);
                
                HAL_Delay(500);
                
                if(BT_Num >= 75 && BT_Num <= 100)
                    epd1in54_showbmp(BT_100);
                else if(BT_Num >= 50 && BT_Num <= 75)
                    epd1in54_showbmp(BT_75);
                else if(BT_Num >= 25 && BT_Num <= 50)
                    epd1in54_showbmp(BT_50);
                else if(BT_Num >= 1 && BT_Num <= 25)
                    epd1in54_showbmp(BT_25);
                else 
                {
                    LED_DisPlay();
                    
                    EPD_1IN54_Clear();
                }
                
                key_flag[0] = 0;
                key_flag[1] = 0;               
            }
            
            /* Displays an NFC-transmitted image copied from */
            if(key_flag[2] == 3) 
            {
                LED_DisPlay();

                nfcBuffer2 = (unsigned char*)ADDR_FLASH_PAGE_470;

                epd1in54_showbmp_updown(nfcBuffer2); 
                
                key_flag[0] = 0;
                key_flag[1] = 0;
                key_flag[2] = 0;
            }
        }    
        else 
            MX_NFC_Process();                  
    }

}

/**
  * @brief System Clock Configuration
  * @retval None
  */
void SystemClock_Config(void)
{
    RCC_OscInitTypeDef RCC_OscInitStruct = {0};
    RCC_ClkInitTypeDef RCC_ClkInitStruct = {0};
    RCC_PeriphCLKInitTypeDef PeriphClkInit = {0};

    /** Configure the main internal regulator output voltage
  */
    __HAL_PWR_VOLTAGESCALING_CONFIG(PWR_REGULATOR_VOLTAGE_SCALE1);
    /** Initializes the CPU, AHB and APB busses clocks
  */
    RCC_OscInitStruct.OscillatorType = RCC_OSCILLATORTYPE_HSI;
    RCC_OscInitStruct.HSIState = RCC_HSI_ON;
    RCC_OscInitStruct.HSICalibrationValue = RCC_HSICALIBRATION_DEFAULT;
    RCC_OscInitStruct.PLL.PLLState = RCC_PLL_NONE;
    if (HAL_RCC_OscConfig(&RCC_OscInitStruct) != HAL_OK)
    {
        Error_Handler();
    }
    /** Initializes the CPU, AHB and APB busses clocks
  */
    RCC_ClkInitStruct.ClockType = RCC_CLOCKTYPE_HCLK | RCC_CLOCKTYPE_SYSCLK
                                  | RCC_CLOCKTYPE_PCLK1 | RCC_CLOCKTYPE_PCLK2;
    RCC_ClkInitStruct.SYSCLKSource = RCC_SYSCLKSOURCE_HSI;
    RCC_ClkInitStruct.AHBCLKDivider = RCC_SYSCLK_DIV1;
    RCC_ClkInitStruct.APB1CLKDivider = RCC_HCLK_DIV1;
    RCC_ClkInitStruct.APB2CLKDivider = RCC_HCLK_DIV1;

    if (HAL_RCC_ClockConfig(&RCC_ClkInitStruct, FLASH_LATENCY_0) != HAL_OK)
    {
        Error_Handler();
    }
    PeriphClkInit.PeriphClockSelection = RCC_PERIPHCLK_USART1 | RCC_PERIPHCLK_I2C1;
    PeriphClkInit.Usart1ClockSelection = RCC_USART1CLKSOURCE_PCLK2;
    PeriphClkInit.I2c1ClockSelection = RCC_I2C1CLKSOURCE_PCLK1;
    if (HAL_RCCEx_PeriphCLKConfig(&PeriphClkInit) != HAL_OK)
    {
        Error_Handler();
    }
}

/* USER CODE BEGIN 4 */
int fputc(int ch, FILE *f)
{
    (void) HAL_UART_Transmit(&huart1, (uint8_t *) &ch, 1, 1000);
    return ch;
}
/* USER CODE END 4 */

/**
  * @brief  This function is executed in case of error occurrence.
  * @retval None
  */
void Error_Handler(void)
{
    /* USER CODE BEGIN Error_Handler_Debug */
    /* User can add his own implementation to report the HAL error return state */

    /* USER CODE END Error_Handler_Debug */
}

#ifdef  USE_FULL_ASSERT
                                                                                                                        /**
  * @brief  Reports the name of the source file and the source line number
  *         where the assert_param error has occurred.
  * @param  file: pointer to the source file name
  * @param  line: assert_param error line source number
  * @retval None
  */
void assert_failed(uint8_t *file, uint32_t line)
{ 
  /* USER CODE BEGIN 6 */
    /* User can add his own implementation to report the file name and line number,
       tex: printf("Wrong parameters value: file %s on line %d\r\n", file, line) */
  /* USER CODE END 6 */
}
#endif /* USE_FULL_ASSERT */

/************************ (C) COPYRIGHT STMicroelectronics *****END OF FILE****/
